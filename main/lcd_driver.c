/**
 * @file lcd_driver.c
 * @brief ILI9341 LCD driver for BYUI e-Badge V4.0 (ESP32-S3-Mini-1-N8)
 *
 * Display: ILI9341, 240x320 native, mounted landscape (FPC connector on left)
 * Interface: SPI2 @ 40 MHz, write-only (no MISO)
 * Orientation: MADCTL 0x60 (MX=1, MV=1) — landscape 320×240
 * Inversion: INVON (0x21) required — panel powers up inverted by default
 *
 * RGB565 byte order: BIG-ENDIAN  (send high byte first, low byte second)
 *   Correct:  uint8_t c[2] = { color >> 8, color & 0xFF }
 *   Example:  RED = 0xF800 → send 0xF8, 0x00 on SPI bus
 *             GREEN = 0x07E0 → send 0x07, 0xE0 on SPI bus
 *             BLUE  = 0x001F → send 0x00, 0x1F on SPI bus
 */

#include "lcd_driver.h"
#include "driver/gpio.h"
#include "driver/spi_master.h"
#include "esp_log.h"
#include "freertos/FreeRTOS.h"
#include "freertos/task.h"
#include <string.h>

// Pin assignments (BYUI e-Badge V4.0)
#define PIN_MOSI    3
#define PIN_CLK    46
#define PIN_CS      0
#define PIN_DC     45
#define PIN_RST     1

// ILI9341 command codes
#define CMD_SWRESET   0x01
#define CMD_SLPOUT    0x11
#define CMD_DISPON    0x29
#define CMD_CASET     0x2A
#define CMD_PASET     0x2B
#define CMD_RAMWR     0x2C
#define CMD_MADCTL    0x36
#define CMD_COLMOD    0x3A
#define CMD_INVON     0x21

// Line buffer for batched fills (320 pixels × 2 bytes — full landscape width)
#define LINE_BUF_PIXELS 320
static uint8_t s_line_buf[LINE_BUF_PIXELS * 2];

static const char *TAG = "lcd";
static spi_device_handle_t s_spi;

// Minimal 8×8 bitmap font (ASCII 32–127)
static const uint8_t font8x8[96][8] = {
    {0x00,0x00,0x00,0x00,0x00,0x00,0x00,0x00}, // ' '
    {0x18,0x3C,0x3C,0x18,0x18,0x00,0x18,0x00}, // '!'
    {0x36,0x36,0x00,0x00,0x00,0x00,0x00,0x00}, // '"'
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    {0x00,0x00,0x00,0x00,0x00,0x00,0x00,0x00}, // DEL
};

// ── Low-level helpers ────────────────────────────────────────────────────────

// DC-pin callback: sets DC atomically before CS asserts, matching badge OS.
// t->user == 0 → command (DC low); t->user == 1 → data (DC high).
static void IRAM_ATTR spi_pre_transfer_cb(spi_transaction_t *t) {
    gpio_set_level(PIN_DC, (int)(intptr_t)t->user);
}

static void lcd_cmd(uint8_t cmd) {
    spi_transaction_t t = {
        .length  = 8,
        .tx_data = {cmd},
        .flags   = SPI_TRANS_USE_TXDATA,
        .user    = (void *)0,   // DC LOW (command)
    };
    spi_device_polling_transmit(s_spi, &t);
}

static void lcd_data_bytes(const uint8_t *data, int len) {
    if (len == 0) return;
    spi_transaction_t t = {
        .length    = (size_t)len * 8,
        .tx_buffer = data,
        .user      = (void *)1, // DC HIGH (data)
    };
    spi_device_polling_transmit(s_spi, &t);
}

// ── Public API ───────────────────────────────────────────────────────────────

esp_err_t lcd_init(void) {
    ESP_LOGI(TAG, "Initialising ILI9341 LCD");

    // Configure RST ALONE first, pre-loaded to LOW.  Matches badge OS
    // display_init() which configures RST separately before anything else.
    // RST must be LOW while the SPI bus and CS pin are being initialised so
    // the ILI9341 ignores any CS glitch that spi_bus_add_device produces when
    // it reconfigures GPIO 0 from input to output.
    gpio_set_level(PIN_RST, 0);
    gpio_config_t rst_cfg = {
        .pin_bit_mask = (1ULL << PIN_RST),
        .mode         = GPIO_MODE_OUTPUT,
    };
    gpio_config(&rst_cfg);

    // Configure DC ALONE, pre-loaded to LOW (command mode).  Matches badge OS
    // spi_and_gpio_init() which explicitly pre-loads DC before gpio_config so
    // the output driver starts in a known state regardless of any LP-pad latch
    // retained from a prior badge OS session.
    gpio_set_level(PIN_DC, 0);
    gpio_config_t dc_cfg = {
        .pin_bit_mask = (1ULL << PIN_DC),
        .mode         = GPIO_MODE_OUTPUT,
    };
    gpio_config(&dc_cfg);

    // SPI bus
    spi_bus_config_t bus = {
        .mosi_io_num     = PIN_MOSI,
        .sclk_io_num     = PIN_CLK,
        .miso_io_num     = -1,
        .quadwp_io_num   = -1,
        .quadhd_io_num   = -1,
        .max_transfer_sz = 4096,
    };
    ESP_ERROR_CHECK(spi_bus_initialize(SPI2_HOST, &bus, SPI_DMA_CH_AUTO));

    // SPI device — pre_cb sets DC atomically before CS asserts, identical to
    // badge OS.  Without pre_cb, a manual gpio_set_level + polling_transmit
    // allows CS to assert before DC is stable on early silicon.
    spi_device_interface_config_t dev = {
        .clock_speed_hz = 40 * 1000 * 1000,
        .mode           = 0,
        .spics_io_num   = PIN_CS,
        .queue_size     = 7,
        .pre_cb         = spi_pre_transfer_cb,
    };
    ESP_ERROR_CHECK(spi_bus_add_device(SPI2_HOST, &dev, &s_spi));

    // RST has been LOW since before SPI init (display in hardware reset).
    // Hold for the ILI9341 minimum (10 µs), then release and stabilise.
    vTaskDelay(pdMS_TO_TICKS(10));
    gpio_set_level(PIN_RST, 1);
    vTaskDelay(pdMS_TO_TICKS(150));

    // Full initialisation sequence — exact copy of badge OS ili9341_init_regs().
    // The vendor-specific registers (0xEF, 0xCF, …) are required on this panel;
    // a minimal SWRESET+SLPOUT+MADCTL sequence is insufficient.
    lcd_cmd(0x01); vTaskDelay(pdMS_TO_TICKS(150)); // SWRESET

    { uint8_t d[] = {0x03,0x80,0x02}; lcd_cmd(0xEF); lcd_data_bytes(d, 3); }
    { uint8_t d[] = {0x00,0xC1,0x30}; lcd_cmd(0xCF); lcd_data_bytes(d, 3); }
    { uint8_t d[] = {0x64,0x03,0x12,0x81}; lcd_cmd(0xED); lcd_data_bytes(d, 4); }
    { uint8_t d[] = {0x85,0x00,0x78}; lcd_cmd(0xE8); lcd_data_bytes(d, 3); }
    { uint8_t d[] = {0x39,0x2C,0x00,0x34,0x02}; lcd_cmd(0xCB); lcd_data_bytes(d, 5); }
    { uint8_t d[] = {0x20}; lcd_cmd(0xF7); lcd_data_bytes(d, 1); }
    { uint8_t d[] = {0x00,0x00}; lcd_cmd(0xEA); lcd_data_bytes(d, 2); }
    { uint8_t d[] = {0x23}; lcd_cmd(0xC0); lcd_data_bytes(d, 1); } // power control 1
    { uint8_t d[] = {0x10}; lcd_cmd(0xC1); lcd_data_bytes(d, 1); } // power control 2
    { uint8_t d[] = {0x3E,0x28}; lcd_cmd(0xC5); lcd_data_bytes(d, 2); } // VCOM
    { uint8_t d[] = {0x86}; lcd_cmd(0xC7); lcd_data_bytes(d, 1); }
    { uint8_t d[] = {0x55}; lcd_cmd(0x3A); lcd_data_bytes(d, 1); } // 16-bit colour
    { uint8_t d[] = {0x00,0x18}; lcd_cmd(0xB1); lcd_data_bytes(d, 2); } // frame rate ~70 Hz
    { uint8_t d[] = {0x08,0x82,0x27}; lcd_cmd(0xB6); lcd_data_bytes(d, 3); }
    { uint8_t d[] = {0x00}; lcd_cmd(0xF2); lcd_data_bytes(d, 1); }
    { uint8_t d[] = {0x01}; lcd_cmd(0x26); lcd_data_bytes(d, 1); }
    { uint8_t d[] = {0x0F,0x31,0x2B,0x0C,0x0E,0x08,0x4E,0xF1,0x37,0x07,0x10,0x03,0x0E,0x09,0x00};
      lcd_cmd(0xE0); lcd_data_bytes(d, 15); }
    { uint8_t d[] = {0x00,0x0E,0x14,0x03,0x11,0x07,0x31,0xC1,0x48,0x08,0x0F,0x0C,0x31,0x36,0x0F};
      lcd_cmd(0xE1); lcd_data_bytes(d, 15); }

    lcd_cmd(0x11); vTaskDelay(pdMS_TO_TICKS(120)); // SLPOUT
    { uint8_t d[] = {0x60}; lcd_cmd(0x36); lcd_data_bytes(d, 1); } // MADCTL: MX=1,MV=1 landscape
    lcd_cmd(0x21);                                                   // INVON
    lcd_cmd(0x29);                                                   // DISPON

    ESP_LOGI(TAG, "LCD ready");
    return ESP_OK;
}

void lcd_set_window(uint16_t x0, uint16_t y0, uint16_t x1, uint16_t y1) {
    uint8_t d[4];

    /* With MADCTL=0x60 (MX=1, MV=1): CASET drives y (short axis 0..239),
     * PASET drives x (long axis 0..319).  Matches badge OS set_window. */
    lcd_cmd(CMD_CASET);
    d[0] = y0 >> 8; d[1] = y0 & 0xFF; d[2] = y1 >> 8; d[3] = y1 & 0xFF;
    lcd_data_bytes(d, 4);

    lcd_cmd(CMD_PASET);
    d[0] = x0 >> 8; d[1] = x0 & 0xFF; d[2] = x1 >> 8; d[3] = x1 & 0xFF;
    lcd_data_bytes(d, 4);

    lcd_cmd(CMD_RAMWR);
}

// Fill a solid rectangle.
// Uses a line buffer so each row is sent in one SPI transaction (much faster
// than the per-pixel approach which would do w*h separate 2-byte transfers).
void lcd_fill_rect(int x, int y, int w, int h, uint16_t color) {
    if (x < 0 || x >= LCD_WIDTH  || y < 0 || y >= LCD_HEIGHT) return;
    if (x + w > LCD_WIDTH)  w = LCD_WIDTH  - x;
    if (y + h > LCD_HEIGHT) h = LCD_HEIGHT - y;
    if (w <= 0 || h <= 0) return;

    // RGB565 big-endian: high byte first, low byte second
    uint8_t hi = color >> 8;
    uint8_t lo = color & 0xFF;

    // Build one row worth of pixel data in the static buffer
    int row_bytes = w * 2;
    for (int i = 0; i < row_bytes; i += 2) {
        s_line_buf[i]     = hi;
        s_line_buf[i + 1] = lo;
    }

    lcd_set_window((uint16_t)x, (uint16_t)y,
                   (uint16_t)(x + w - 1), (uint16_t)(y + h - 1));
    spi_transaction_t t = { .length = (size_t)row_bytes * 8, .tx_buffer = s_line_buf,
                             .user = (void *)1 };  // pre_cb → DC HIGH (data)
    for (int row = 0; row < h; row++) {
        spi_device_polling_transmit(s_spi, &t);
    }
}

void lcd_fill_screen(uint16_t color) {
    lcd_fill_rect(0, 0, LCD_WIDTH, LCD_HEIGHT, color);
}

void lcd_draw_pixel(int x, int y, uint16_t color) {
    if (x < 0 || x >= LCD_WIDTH || y < 0 || y >= LCD_HEIGHT) return;
    lcd_set_window((uint16_t)x, (uint16_t)y, (uint16_t)x, (uint16_t)y);
    // RGB565 big-endian: high byte first
    uint8_t c[2] = { color >> 8, color & 0xFF };
    lcd_data_bytes(c, 2);
}

// Draw an unfilled rectangle border
void lcd_draw_rect_outline(int x, int y, int w, int h, uint16_t color) {
    // Draw as four filled 1-pixel-wide rects for efficiency
    lcd_fill_rect(x,         y,         w, 1, color); // top
    lcd_fill_rect(x,         y + h - 1, w, 1, color); // bottom
    lcd_fill_rect(x,         y,         1, h, color); // left
    lcd_fill_rect(x + w - 1, y,         1, h, color); // right
}

// Draw a single 8×8 character
static void lcd_draw_char(int x, int y, char c, uint16_t fg, uint16_t bg) {
    if (c < 32 || c > 127) c = 32;
    int idx = c - 32;

    // RGB565 big-endian: high byte first
    uint8_t hi_fg = fg >> 8, lo_fg = fg & 0xFF;
    uint8_t hi_bg = bg >> 8, lo_bg = bg & 0xFF;

    // Build whole character (8×8 pixels) in one buffer, send in one transaction
    // Buffer: 8 rows × 8 cols × 2 bytes = 128 bytes
    uint8_t buf[128];
    for (int row = 0; row < 8; row++) {
        uint8_t bits = (idx < 96) ? font8x8[idx][row] : 0;
        for (int col = 0; col < 8; col++) {
            int pos = (row * 8 + col) * 2;
            if (bits & (1 << col)) {
                buf[pos]     = hi_fg;
                buf[pos + 1] = lo_fg;
            } else {
                buf[pos]     = hi_bg;
                buf[pos + 1] = lo_bg;
            }
        }
    }
    lcd_set_window((uint16_t)x, (uint16_t)y,
                   (uint16_t)(x + 7), (uint16_t)(y + 7));
    lcd_data_bytes(buf, 128);
}

void lcd_draw_string(int x, int y, const char *str, uint16_t fg, uint16_t bg) {
    int cx = x;
    while (*str) {
        lcd_draw_char(cx, y, *str++, fg, bg);
        cx += 8;
    }
}

// Draw a single 8×8 character scaled 2× (renders as 16×16)
static void lcd_draw_char_2x(int x, int y, char c, uint16_t fg, uint16_t bg) {
    if (c < 32 || c > 127) c = 32;
    int idx = c - 32;
    uint8_t hi_fg = fg >> 8, lo_fg = fg & 0xFF;
    uint8_t hi_bg = bg >> 8, lo_bg = bg & 0xFF;
    uint8_t buf[512]; // 16×16 × 2 bytes
    for (int row = 0; row < 8; row++) {
        uint8_t bits = (idx < 96) ? font8x8[idx][row] : 0;
        for (int col = 0; col < 8; col++) {
            uint8_t hi = (bits & (1 << col)) ? hi_fg : hi_bg;
            uint8_t lo = (bits & (1 << col)) ? lo_fg : lo_bg;
            for (int dr = 0; dr < 2; dr++) {
                int pos = ((row * 2 + dr) * 16 + col * 2) * 2;
                buf[pos]   = hi; buf[pos+1] = lo;
                buf[pos+2] = hi; buf[pos+3] = lo;
            }
        }
    }
    lcd_set_window((uint16_t)x, (uint16_t)y, (uint16_t)(x+15), (uint16_t)(y+15));
    lcd_data_bytes(buf, 512);
}

void lcd_draw_string_2x(int x, int y, const char *str, uint16_t fg, uint16_t bg) {
    int cx = x;
    while (*str) {
        lcd_draw_char_2x(cx, y, *str++, fg, bg);
        cx += 16;
    }
}
